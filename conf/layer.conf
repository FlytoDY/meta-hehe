## conf/layer.conf
```bitbake
# We have a conf and classes directory, add to BBPATH
BBPATH .= ":${LAYERDIR}"

# We have recipes-* directories, add to BBFILES
BBFILES += "${LAYERDIR}/recipes-*/*/*.bb \
            ${LAYERDIR}/recipes-*/*/*.bbappend"

BBFILE_COLLECTIONS += "meta-hehe"
BBFILE_PATTERN_meta-hehe = "^${LAYERDIR}/"
BBFILE_PRIORITY_meta-hehe = "6"

LAYERDEPENDS_meta-hehe = "core"
LAYERSERIES_COMPAT_meta-hehe = "hardknott"
```
